VERSION "1.0"

NS_ :

BS_:

BU_: Vehicle_ECU

BO_ 256 VehicleSpeed: 2 Vehicle_ECU
 SG_ VehicleSpeed : 0|16@1+ (0.1,0) [0|120] "km/h" Vector__XXX

BO_ 257 EngineRPM: 2 Vehicle_ECU
 SG_ EngineRPM : 0|16@1+ (1,0) [800|5000] "rpm" Vector__XXX

BO_ 258 CoolantTemperature: 2 Vehicle_ECU
 SG_ CoolantTemperature : 0|16@1+ (0.1,0) [20|120] "degC" Vector__XXX

BO_ 259 FuelLevel: 1 Vehicle_ECU
 SG_ FuelLevel : 0|8@1+ (1,0) [0|100] "%" Vector__XXX

BO_ 260 BatteryVoltage: 2 Vehicle_ECU
 SG_ BatteryVoltage : 0|16@1+ (0.01,0) [11|15] "V" Vector__XXX
BO_ 261 AmbientTemperature: 2 Vehicle_ECU
 SG_ AmbientTemperature : 0|16@1+ (0.1,0) [-20|60] "degC" Vector__XXX
